## firmware/main/Kconfig.projbuild
```kconfig
menu "FM1 Cartridge"
    config FM1_ENABLE_UAC_TX
        bool "Enable experimental UAC1 audio TX"
        default n
        help
            Requires a device with a working PCM16 stereo 44.1 kHz ISO OUT.
            Current upstream SLOOP does not provide this input. Validate its
            new USB audio input with a computer before enabling this option.

    choice FM1_AUDIO_SOURCE
        prompt "Audio source"
        depends on FM1_ENABLE_UAC_TX
        default FM1_AUDIO_TONE
        config FM1_AUDIO_TONE
            bool "440 Hz bench tone (-20 dBFS)"
        config FM1_AUDIO_CLIPPER
            bool "Clipper synthesizer (USB-MIDI, experimental)"
            depends on SPIRAM
            select SPIRAM_ALLOW_BSS_SEG_EXTERNAL_MEMORY
        config FM1_AUDIO_FELUCCA
            bool "Felucca 1.7.0 synthesizer (USB-MIDI, experimental)"
            depends on SPIRAM
            select SPIRAM_ALLOW_BSS_SEG_EXTERNAL_MEMORY
        config FM1_AUDIO_MELODEE
            bool "Melodee 1.5.1 synthesizer (USB-MIDI, experimental)"
            depends on SPIRAM
            select SPIRAM_ALLOW_BSS_SEG_EXTERNAL_MEMORY
    endchoice

    config FM1_AUDIO_SYNTH
        bool
        default y if FM1_AUDIO_CLIPPER || FM1_AUDIO_FELUCCA || FM1_AUDIO_MELODEE
        default n

    config FM1_SYNTH_ENGINE
        int "Engine index at boot"
        depends on FM1_AUDIO_SYNTH
        range 0 31
        default 0
        help
            Validated at boot against the linked synthesizer's catalogue; an
            invalid index aborts with an explicit error.

    config FM1_SYNTH_PRESET
        int "Preset index at boot (validated at boot)"
        depends on FM1_AUDIO_SYNTH
        range 0 255
        default 0

    config FM1_MIDI_CHANNEL
        int "MIDI channel the synthesizer answers at boot (0 = omni)"
        depends on FM1_AUDIO_SYNTH
        range 0 16
        default 1
        help
            The FM-1 sends each track on its own channel (GLO > MIDI: CH1..CH3,
            DR CH). 1 plays the cartridge from track 1 only; 0 answers every
            channel. Changeable live as the first CARTRIDGE page parameter, MIDI CH.

    config FM1_UAC_BUFFER_BYTES
        int "UAC: bytes of PCM the render keeps ahead of the URBs"
        depends on FM1_ENABLE_UAC_TX
        range 1024 8192
        default 2048
        help
            The ring between the audio task and the isochronous URBs (4 bytes a
            stereo frame: 2048 B is 11.6 ms). The task blocks when it is full, so
            it stays nearly full: this is most of the cartridge's own latency.
            Smaller cuts latency and leaves less room for a slow render pass
            (render_max_us, pass_max_us and underruns on the UART show it).

    config FM1_BATTERY
        bool "Read the cell through a divider on an ADC pin"
        depends on FM1_AUDIO_SYNTH
        default n
        help
            The Super Mini gives the firmware no battery reading of its own: this
            needs a divider wired from BAT+ to an ADC1 pin (hardware/README.md,
            battery reading). The cartridge then sends the cell's level to the
            FM-1 (CART_BATTERY, CART_POWER), which shows it on the CARTRIDGE page,
            and fades its audio out at the cutoff.

    config FM1_BATTERY_GPIO
        int "ADC1 pin of the divider (GPIO1..GPIO10; not GPIO3, a strapping pin)"
        depends on FM1_BATTERY
        range 1 10
        default 1

    config FM1_BATTERY_DIVIDER
        int "Divider ratio x1000: the cell's voltage over the pin's"
        depends on FM1_BATTERY
        range 1000 4000
        default 2000
        help
            2000 for two equal resistors (100 kOhm each: 4.2 V reads 2.1 V on the
            pin, within the ADC's 12 dB range, and the divider draws 21 uA).

    config FM1_BATTERY_LOW_MV
        int "mV under which the FM-1 shows the cell as LOW"
        depends on FM1_BATTERY
        range 3000 4200
        default 3700

    config FM1_BATTERY_CUTOFF_MV
        int "mV under which the cartridge fades its audio out until the next start"
        depends on FM1_BATTERY
        range 3000 4200
        default 3550
        help
            Five readings in a row (about 5 s) under this level fade the audio out
            over 100 ms; it stays silent until the next start. On the prototype the
            3V3 rail already reads 2.77 V with the cell at 3.56 V (BENCH_TESTS.md):
            set this from the G6 measurement of where 3V3 leaves its range.

    config FM1_SLOT_SWITCH_MS
        int "FIRMWARE: ms the knob rests on another slot before rebooting into it"
        range 500 10000
        default 2000
        help
            GLO > CARTRIDGE > parameter FIRMWARE (knob 3), value (knob 4): the
            slot the value rests on for this long is set as the boot partition
            and the cartridge restarts. Turning back to the running slot, moving
            knob 3 off FIRMWARE or leaving the page (Sloop sends a query) cancels;
            while the FM-1 holds notes or its transport runs, the value stays on
            the running slot.
endmenu
```
